## linux_dir/fs/ext4/Kconfig
```kconfig
config EXT4_FS
	tristate "The Extended 4 (ext4) filesystem"
	depends on JBD2
	select CRC16
	help
	  This is the next generation of the ext3 filesystem.

	  Unlike the change from ext2 filesystem to ext3 filesystem,
	  the on-disk format of ext4 is not forwards compatible with
	  ext3; it is based on extent maps and it supports 48-bit
	  physical block numbers.  The ext4 filesystem also supports delayed
	  allocation, persistent preallocation, high resolution time stamps,
	  and a number of other features to improve performance and speed
	  up fsck time.  For more information, please see the web pages at
	  http://ext4.wiki.kernel.org.

	  The ext4 filesystem will support mounting an ext3
	  filesystem; while there will be some performance gains from
	  the delayed allocation and inode table readahead, the best
	  performance gains will require enabling ext4 features in the
	  filesystem, or formatting a new filesystem as an ext4
	  filesystem initially.

	  To compile this file system support as a module, choose M here. The
	  module will be called ext4.

	  If unsure, say N.

config EXT4_USE_FOR_EXT23
	bool "Use ext4 for ext2/ext3 file systems"
	depends on EXT4_FS
	depends on EXT3_FS=n || EXT2_FS=n
	default y
	help
	  Allow the ext4 file system driver code to be used for ext2 or
	  ext3 file system mounts.  This allows users to reduce their
	  compiled kernel size by using one file system driver for
	  ext2, ext3, and ext4 file systems.

config EXT4_FS_XATTR
	bool "Ext4 extended attributes"
	depends on EXT4_FS
	default y
	help
	  Extended attributes are name:value pairs associated with inodes by
	  the kernel or by users (see the attr(5) manual page, or visit
	  <http://acl.bestbits.at/> for details).

	  If unsure, say N.

	  You need this for POSIX ACL support on ext4.

config EXT4_FS_POSIX_ACL
	bool "Ext4 POSIX Access Control Lists"
	depends on EXT4_FS_XATTR
	depends on FS_POSIX_ACL
	help
	  POSIX Access Control Lists (ACLs) support permissions for users and
	  groups beyond the owner/group/world scheme.

	  To learn more about Access Control Lists, visit the POSIX ACLs for
	  Linux website <http://acl.bestbits.at/>.

	  If you don't know what Access Control Lists are, say N

config EXT4_FS_SECURITY
	bool "Ext4 Security Labels"
	depends on EXT4_FS_XATTR
	help
	  Security labels support alternative access control models
	  implemented by security modules like SELinux.  This option
	  enables an extended attribute handler for file security
	  labels in the ext4 filesystem.

	  If you are not using a security module that requires using
	  extended attributes for file security labels, say N.

config EXT4_FS_DEBUG
	bool "snapshot debugging support"
	depends on EXT4_FS && DEBUG_FS
	default y
	help
	  Control snapshot debug level via debugfs entry /ext4/snapshot-debug.
	  Control snapshot unit tests via debugfs entries /ext4/test-XXX.

config EXT4_FS_SNAPSHOT
	bool "snapshot support"
	depends on EXT4_FS
	default y
	help
	  If you say N here, then Ext4 will be identical to Ext3.

config EXT4_DEBUG
	bool "EXT4 debugging support"
	depends on EXT4_FS
	help
	  Enables run-time debugging support for the ext4 filesystem.

	  If you select Y here, then you will be able to turn on debugging
	  with a command such as "echo 1 > /sys/kernel/debug/ext4/mballoc-debug"

config EXT4_FS_SNAPSHOT_HOOKS_JBD
	bool "snapshot hooks - inside JBD hooks"
	depends on EXT4_FS_SNAPSHOT
	default y
	help
	  Before every meta data buffer write, the journal API is called,
	  namely, one of the ext4_journal_get_XXX_access() functions.
	  We use these journal hooks to call the snapshot API,
	  before every meta data buffer write.

config EXT4_FS_SNAPSHOT_HOOKS_DELETE
	bool "snapshot hooks - delete blocks"
	depends on EXT4_FS_SNAPSHOT
	default y
	help
	  Before deleting file blocks in ext4_free_blocks(),
	  we call the snapshot API snapshot_get_delete_access(),
	  to optionally move the block to the snapshot file.

config EXT4_FS_SNAPSHOT_HOOKS_DATA
	bool "snapshot hooks - move data blocks"
	depends on EXT4_FS_SNAPSHOT
	default y
	help
	  Before every regular file data buffer write,
	  the function ext4_get_block() is called to map the buffer to disk.
	  We use this hook to call the snapshot API snapshot_get_move_access(),
	  to optionally move the block to the snapshot file.

config EXT4_FS_SNAPSHOT_FILE
	bool "snapshot file"
	depends on EXT4_FS_SNAPSHOT
	default y
	help
	  Ext4 snapshot implementation as a file inside the file system.
	  Snapshot files are marked with the snapfile flag and have special
	  read-only address space ops.

config EXT4_FS_SNAPSHOT_FILE_READ
	bool "snapshot file - read through to block device"
	depends on EXT4_FS_SNAPSHOT_FILE
	default y
	help
	  On active snapshot file page read, the function ext4_get_block()
	  is called to map the page to a disk block.  If the page is not mapped
	  in the snapshot file a direct mapping to the block device is returned.

config EXT4_FS_SNAPSHOT_FILE_PERM
	bool "snapshot file - permissions"
	depends on EXT4_FS_SNAPSHOT_FILE
	default y
	help
	  Enforce snapshot file permissions.
	  Write, truncate and unlink of snapshot inodes is not allowed.

config EXT4_FS_SNAPSHOT_FILE_STORE
	bool "snapshot file - store on disk"
	depends on EXT4_FS_SNAPSHOT_FILE
	default y
	help
	  Snapshot inode is stored differently in memory and on disk.
	  During store and load of snapshot inode, some of the inode flags
	  and fields are converted.

config EXT4_FS_SNAPSHOT_FILE_HUGE
	bool "snapshot file - increase maximum file size limit to 16TB"
	depends on EXT4_FS_SNAPSHOT_FILE
	default y
	help
	  Files larger than 2TB use Ext4 huge_file flag to store i_blocks
	  in file system blocks units, so the upper limit on snapshot actual
	  size is increased from 512*2^32 = 2TB to 4K*2^32 = 16TB,
	  which is also the upper limit on file system size.
	  To map 2^32 logical blocks, 4 triple indirect blocks are used instead
	  of just one.  The extra 3 triple indirect blocks are stored in-place
	  of direct blocks, which are not in use by snapshot files.

config EXT4_FS_SNAPSHOT_FILE_OLD
	bool "snapshot file - migrate old on-disk format"
	depends on EXT4_FS_SNAPSHOT_FILE
	default y
	help
	  Snapshot flags and super block field positions have changed.
	  When old has_snapshot flag is set, copy fields to new position,
	  clear old flags and fields and set new flags on mount time.

config EXT4_FS_SNAPSHOT_BLOCK
	bool "snapshot block operations"
	depends on EXT4_FS_SNAPSHOT_FILE
	default y
	help
	  Core implementation of special snapshot file block operations.
	  The argument @create to the function ext4_get_blocks_handle()
	  is re-interpreted as a snapshot block command argument.  The old
	  argument values 0(=read) and 1(=create) preserve the original
	  behavior of the function.  The bit field h_cowing in the current
	  transaction handle is used to prevent COW recursions.

config EXT4_FS_SNAPSHOT_BLOCK_COW
	bool "snapshot block operation - copy blocks to snapshot"
	depends on EXT4_FS_SNAPSHOT_BLOCK
	default y
	help
	  Implementation of copying blocks into a snapshot file.
	  This mechanism is used to copy-on-write metadata blocks to snapshot.


config EXT4_FS_SNAPSHOT_JOURNAL
	bool "snapshot journaled"
	depends on EXT4_FS_SNAPSHOT_BLOCK
	default y
	help
	  Ext4 snapshot operations are journaled inside the same transaction
	  with the file system operation that triggered them.


config EXT4_FS_SNAPSHOT_JOURNAL_ERROR
	bool "snapshot journaled - record errors in journal"
	depends on EXT4_FS_SNAPSHOT_JOURNAL
	default y
	help
	  Ext4 error state is recorded in the journal super block and error
	  messages are recorder in free space after the journal super block.
	  Ext4 should be mounted with errors=remount-ro.
	  After a snapshot error, the file system will be in read-only mode.
	  The administrator must un-mount the file system and run fsck
	  to prevent data corruption.
	  Some places in Ext3 original code don't check for return value of
	  JBD functions.  Check for snapshot/journal errors in those places.


config EXT4_FS_SNAPSHOT_BLOCK_MOVE
	bool "snapshot block operation - move blocks to snapshot"
	depends on EXT4_FS_SNAPSHOT_BLOCK
	default y
	help
	  Implementation of moving blocks into a snapshot file.
	  The move block command maps an allocated blocks to the snapshot file,
	  allocating only the indirect blocks when needed.
	  This mechanism is used to move-on-write data blocks to snapshot.

config EXT4_FS_SNAPSHOT_BLOCK_BITMAP
	bool "snapshot block operation - copy block bitmap to snapshot"
	depends on EXT4_FS_SNAPSHOT_BLOCK
	default y
	help
	  The snapshot copy of the file system block bitmap is called the COW
	  bitmap and it is used to check if a block was allocated at the time
	  that the snapshot was taken.
```
